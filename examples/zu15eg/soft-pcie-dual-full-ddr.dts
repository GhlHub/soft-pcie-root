// SPDX-License-Identifier: Apache-2.0
#include "soft-pcie-dual.dts"

&soft_pcie_root {
 dma-ranges = <0x02000000 0x0 0x0 0x0 0x0 0x0 0x80000000>,
              <0x03000000 0x8 0x0 0x8 0x0 0x0 0x80000000>;
};

&soft_pcie_b {
 dma-ranges = <0x02000000 0x0 0x0 0x0 0x0 0x0 0x80000000>,
              <0x03000000 0x8 0x0 0x8 0x0 0x0 0x80000000>;
};
