## software/driver/Config.in
```kconfig
config BR2_PACKAGE_ZCU104_PCIE_HOST
 bool "ZCU104 experimental soft PCIe host driver"
 depends on BR2_LINUX_KERNEL
 help
   GPL-2.0-only platform PCI host driver for this project's soft root port.
   Loaded only by the explicit PL-first host DT profile, never the baseline DT.
```

## software/linux/buildroot/Config.in
```kconfig
source "$BR2_EXTERNAL_ZCU104_PATH/package/zcu104-tools/Config.in"
source "$BR2_EXTERNAL_ZCU104_PATH/../../driver/Config.in"
```

## software/linux/buildroot/configs/zcu104_server_defconfig
```kconfig
BR2_TOOLCHAIN_BARE_METAL_BUILDROOT=y
BR2_TOOLCHAIN_BARE_METAL_BUILDROOT_ARCH="microblazeel-xilinx-elf"
BR2_GLOBAL_PATCH_DIR="board/zynqmp/patches board/xilinx/patches"
BR2_DOWNLOAD_FORCE_CHECK_HASHES=y
BR2_ROOTFS_POST_BUILD_SCRIPT="$(BR2_EXTERNAL_ZCU104_PATH)/board/post-build.sh"
BR2_ROOTFS_POST_IMAGE_SCRIPT="$(BR2_EXTERNAL_ZCU104_PATH)/board/post-image.sh"
BR2_LINUX_KERNEL=y
BR2_LINUX_KERNEL_CUSTOM_TARBALL=y
BR2_LINUX_KERNEL_CUSTOM_TARBALL_LOCATION="$(call github,Xilinx,linux-xlnx,xlnx_rebase_v6.6_LTS_merge_6.6.70)/xlnx_rebase_v6.6_LTS_merge_6.6.70.tar.gz"
BR2_LINUX_KERNEL_DEFCONFIG="xilinx"
BR2_LINUX_KERNEL_DTS_SUPPORT=y
BR2_LINUX_KERNEL_INTREE_DTS_NAME="xilinx/zynqmp-zcu104-revC"
BR2_LINUX_KERNEL_NEEDS_HOST_OPENSSL=y
BR2_TARGET_ROOTFS_EXT2=y
BR2_TARGET_ROOTFS_EXT2_4=y
BR2_TARGET_ARM_TRUSTED_FIRMWARE=y
BR2_TARGET_ARM_TRUSTED_FIRMWARE_CUSTOM_TARBALL=y
BR2_TARGET_ARM_TRUSTED_FIRMWARE_CUSTOM_TARBALL_LOCATION="$(call github,Xilinx,arm-trusted-firmware,xlnx_rebase_v2.10_2024.2)/xlnx_rebase_v2.10_2024.2.tar.gz"
BR2_TARGET_ARM_TRUSTED_FIRMWARE_PLATFORM="zynqmp"
BR2_TARGET_ARM_TRUSTED_FIRMWARE_BL31_UBOOT=y
BR2_TARGET_UBOOT=y
BR2_TARGET_UBOOT_BUILD_SYSTEM_KCONFIG=y
BR2_TARGET_UBOOT_CUSTOM_TARBALL=y
BR2_TARGET_UBOOT_CUSTOM_TARBALL_LOCATION="$(call github,Xilinx,u-boot-xlnx,xlnx_rebase_v2024.01_2024.2)/xlnx_rebase_v2024.01_2024.2.tar.gz"
BR2_TARGET_UBOOT_BOARD_DEFCONFIG="xilinx_zynqmp_virt"
BR2_TARGET_UBOOT_NEEDS_DTC=y
BR2_TARGET_UBOOT_NEEDS_OPENSSL=y
BR2_TARGET_UBOOT_NEEDS_GNUTLS=y
BR2_TARGET_UBOOT_NEEDS_UTIL_LINUX=y
BR2_TARGET_UBOOT_NEEDS_ATF_BL31=y
BR2_TARGET_UBOOT_USE_BINMAN=y
BR2_TARGET_UBOOT_FORMAT_ITB=y
BR2_TARGET_UBOOT_FORMAT_QSPI_BIN=y
BR2_TARGET_UBOOT_SPL=y
BR2_TARGET_UBOOT_SPL_NAME="spl/boot.bin"
BR2_TARGET_UBOOT_ZYNQMP=y
BR2_TARGET_UBOOT_ZYNQMP_PMUFW_EMBEDDEDSW=y
BR2_TARGET_UBOOT_ZYNQMP_PM_CFG="board/zynqmp/zcu104/pm_cfg_obj.c"
BR2_TARGET_UBOOT_CUSTOM_MAKEOPTS="DEVICE_TREE=zynqmp-zcu104-revC"
BR2_TARGET_XILINX_EMBEDDEDSW=y
BR2_TARGET_XILINX_EMBEDDEDSW_ZYNQMP_PMUFW=y
BR2_PACKAGE_HOST_DOSFSTOOLS=y
BR2_PACKAGE_HOST_GENIMAGE=y
BR2_PACKAGE_HOST_MTOOLS=y

BR2_aarch64=y
BR2_cortex_a53=y
BR2_TOOLCHAIN_EXTERNAL=y
BR2_TOOLCHAIN_EXTERNAL_BOOTLIN=y
BR2_TOOLCHAIN_EXTERNAL_BOOTLIN_AARCH64_GLIBC_STABLE=y
BR2_REPRODUCIBLE=y
BR2_INIT_BUSYBOX=y
BR2_ROOTFS_DEVICE_CREATION_DYNAMIC_MDEV=y
BR2_TARGET_GENERIC_GETTY_PORT="ttyPS0"
BR2_PACKAGE_BUSYBOX_SHOW_OTHERS=y
BR2_PACKAGE_MDADM=y
BR2_PACKAGE_BTRFS_PROGS=y
BR2_PACKAGE_ZSTD=y
BR2_PACKAGE_UTIL_LINUX=y
BR2_PACKAGE_UTIL_LINUX_BINARIES=y
BR2_PACKAGE_UTIL_LINUX_MOUNT=y
BR2_PACKAGE_UTIL_LINUX_MOUNTPOINT=y
BR2_PACKAGE_UTIL_LINUX_FSCK=y
BR2_PACKAGE_UTIL_LINUX_PARTX=y
BR2_PACKAGE_UTIL_LINUX_LOSETUP=y
BR2_PACKAGE_UTIL_LINUX_WIPEFS=y
BR2_PACKAGE_PARTED=y
BR2_PACKAGE_GPTFDISK=y
BR2_PACKAGE_GPTFDISK_GDISK=y
BR2_PACKAGE_GPTFDISK_SGDISK=y
BR2_PACKAGE_SMARTMONTOOLS=y
BR2_PACKAGE_HDPARM=y
BR2_PACKAGE_NVME=y
BR2_PACKAGE_SG3_UTILS=y
BR2_PACKAGE_SG3_UTILS_PROGS=y
BR2_PACKAGE_E2FSPROGS=y
BR2_PACKAGE_E2FSPROGS_RESIZE2FS=y
BR2_PACKAGE_DOSFSTOOLS=y
BR2_PACKAGE_DOSFSTOOLS_FSCK_FAT=y
BR2_PACKAGE_DOSFSTOOLS_MKFS_FAT=y
BR2_PACKAGE_LVM2=y
BR2_PACKAGE_LVM2_STANDARD_INSTALL=y
BR2_PACKAGE_CRYPTSETUP=y
BR2_PACKAGE_FIO=y
BR2_PACKAGE_RSYNC=y
BR2_PACKAGE_IPROUTE2=y
BR2_PACKAGE_ETHTOOL=y
BR2_PACKAGE_PCIUTILS=y
BR2_PACKAGE_PROCPS_NG=y
BR2_PACKAGE_KMOD=y
BR2_PACKAGE_KMOD_TOOLS=y
BR2_TARGET_ROOTFS_CPIO=y
BR2_TARGET_ROOTFS_CPIO_GZIP=y
BR2_TARGET_ROOTFS_TAR=y

# NAS sharing, remote administration and network diagnostics.
BR2_PACKAGE_NFS_UTILS=y
BR2_PACKAGE_NFS_UTILS_NFSV4=y
BR2_PACKAGE_NFS_UTILS_RPC_NFSD=y
BR2_PACKAGE_NFS_UTILS_RPCDEBUG=y
BR2_PACKAGE_ACL=y
BR2_PACKAGE_ATTR=y
BR2_PACKAGE_SAMBA4=y
# BR2_PACKAGE_SAMBA4_AD_DC is not set
BR2_PACKAGE_CIFS_UTILS=y
BR2_PACKAGE_LIBOPENSSL_BIN=y
BR2_PACKAGE_OPENSSH=y
BR2_PACKAGE_OPENSSH_CLIENT=y
BR2_PACKAGE_OPENSSH_SERVER=y
BR2_PACKAGE_OPENSSH_KEY_UTILS=y
BR2_PACKAGE_DNSMASQ=y
BR2_PACKAGE_DNSMASQ_DHCP=y
BR2_PACKAGE_IPUTILS=y
BR2_PACKAGE_IPUTILS_PING=y
BR2_PACKAGE_IPUTILS_ARPING=y
BR2_PACKAGE_IPUTILS_TRACEPATH=y
BR2_PACKAGE_TRACEROUTE=y
BR2_PACKAGE_TCPDUMP=y
BR2_PACKAGE_IPERF3=y
BR2_PACKAGE_BIND=y
BR2_PACKAGE_BIND_TOOLS=y
# BR2_PACKAGE_BIND_SERVER is not set
BR2_PACKAGE_NFTABLES=y
BR2_PACKAGE_CONNTRACK_TOOLS=y
BR2_PACKAGE_SOCAT=y
BR2_PACKAGE_NET_TOOLS=y
BR2_PACKAGE_LIBCURL=y
BR2_PACKAGE_LIBCURL_CURL=y
BR2_PACKAGE_LIBCURL_OPENSSL=y
BR2_PACKAGE_CA_CERTIFICATES=y
BR2_TARGET_GENERIC_HOSTNAME="zcu104-pcie"
BR2_TARGET_GENERIC_ISSUE="ZCU104 soft PCIe development server"
BR2_ROOTFS_OVERLAY="$(BR2_EXTERNAL_ZCU104_PATH)/board/rootfs-overlay"
BR2_LINUX_KERNEL_CONFIG_FRAGMENT_FILES="$(BR2_EXTERNAL_ZCU104_PATH)/../kernel/server.config"
BR2_TARGET_ROOTFS_EXT2_SIZE="1024M"
BR2_TARGET_ROOTFS_EXT2_LABEL="zcu104-root"
BR2_PACKAGE_BASH=y
BR2_PACKAGE_HTOP=y
BR2_PACKAGE_STRACE=y
BR2_PACKAGE_TMUX=y
BR2_PACKAGE_VIM=y
BR2_PACKAGE_LESS=y
BR2_PACKAGE_PYTHON3=y
BR2_PACKAGE_CHRONY=y
BR2_PACKAGE_LOGROTATE=y
BR2_PACKAGE_WGET=y
BR2_PACKAGE_GIT=y
BR2_PACKAGE_SUDO=y
BR2_SYSTEM_DHCP="eth0"
BR2_PACKAGE_ZCU104_TOOLS=y
BR2_PACKAGE_COREUTILS=y
BR2_TOOLCHAIN_GLIBC_GCONV_LIBS_COPY=y
BR2_TOOLCHAIN_GLIBC_GCONV_LIBS_LIST=""
BR2_PACKAGE_PYTHON3_SQLITE=y
BR2_PACKAGE_ZCU104_PCIE_HOST=y
```

## software/linux/buildroot/package/zcu104-tools/Config.in
```kconfig
config BR2_PACKAGE_ZCU104_TOOLS
 bool "ZCU104 soft PCIe laboratory tools"
 help
   Bounded UIO control and configuration-read utility; not a PCI host driver.
```
