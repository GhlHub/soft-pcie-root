/dts-v1/;
#include "zynqmp-zcu104-revC.dts"
/ {
 model = "ZCU104 experimental soft PCIe NVMe host";
 soft_pcie_root: pcie@a0000000 {
  compatible = "ngt,zcu104-soft-pcie-1.0";
  device_type = "pci";
  #address-cells = <3>;
  #size-cells = <2>;
  reg = <0 0xa0000000 0 0x1000>, <0 0xa2000000 0 0x1000>;
  reg-names = "config", "host";
  bus-range = <1 1>;
  linux,pci-domain = <1>;
  ranges = <0x02000000 0 0xa3000000 0 0xa3000000 0 0x01000000>;
  dma-ranges = <0x02000000 0 0 0 0 0 0x80000000>;
  interrupt-parent = <&gic>;
  interrupts = <GIC_SPI 89 IRQ_TYPE_LEVEL_HIGH>;
  status = "okay";
 };
};
